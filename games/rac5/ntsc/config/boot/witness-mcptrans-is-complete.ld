/* Address facts for a local candidate link; no game bytes. */
transition_active = 0x01EF037D;
completion_flag = 0x01EF037C;
transition_state = 0x01F66C30;
SECTIONS { . = 0x01E68F00; .text : { *(.text) } }
